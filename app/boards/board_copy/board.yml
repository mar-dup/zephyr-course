## app/boards/board_copy/board.yml
```yaml
board:
  name: board_copy
  full_name: board that was copied
  vendor: amazingSoft
  socs:
  - name: esp32h2
```

## app/boards/board_scratch/Kconfig.board_scratch
```kconfig
config BOARD_BOARD_SCRATCH
	select SOC_ESP32_H2_MINI_H4
	select BOARD_BOARD_SCRATCH_INIT_HOOK
```

## app/boards/board_scratch/board.yml
```yaml
board:
  name: board_scratch
  full_name: board that was done from scratch
  vendor: amazingSoft
  socs:
  - name: esp32h2
```

## twister-out/native_sim_native/host/zephyr-course/tests/ring_buf/homework.unit.ring_buf/Kconfig/Kconfig.modules
```kconfig
menu "hal_espressif (/home/marvin/workspace/courses/iomico_zephyr_foundation/deps/modules/hal/espressif)"
osource "/home/marvin/workspace/courses/iomico_zephyr_foundation/deps/modules/hal/espressif/zephyr/Kconfig"
config ZEPHYR_HAL_ESPRESSIF_MODULE
	bool
	default y

config ZEPHYR_HAL_ESPRESSIF_MODULE_BLOBS
	bool
endmenu
```

## twister-out/native_sim_native/host/zephyr-course/tests/ring_buf/homework.unit.ring_buf/Kconfig/arch/Kconfig
```kconfig
# Load Zephyr Arch Kconfig descriptions.
osource "/home/marvin/workspace/courses/iomico_zephyr_foundation/deps/zephyr/arch/rx/Kconfig"
osource "/home/marvin/workspace/courses/iomico_zephyr_foundation/deps/zephyr/arch/x86/Kconfig"
osource "/home/marvin/workspace/courses/iomico_zephyr_foundation/deps/zephyr/arch/xtensa/Kconfig"
osource "/home/marvin/workspace/courses/iomico_zephyr_foundation/deps/zephyr/arch/sparc/Kconfig"
osource "/home/marvin/workspace/courses/iomico_zephyr_foundation/deps/zephyr/arch/riscv/Kconfig"
osource "/home/marvin/workspace/courses/iomico_zephyr_foundation/deps/zephyr/arch/posix/Kconfig"
osource "/home/marvin/workspace/courses/iomico_zephyr_foundation/deps/zephyr/arch/mips/Kconfig"
osource "/home/marvin/workspace/courses/iomico_zephyr_foundation/deps/zephyr/arch/arm64/Kconfig"
osource "/home/marvin/workspace/courses/iomico_zephyr_foundation/deps/zephyr/arch/arm/Kconfig"
osource "/home/marvin/workspace/courses/iomico_zephyr_foundation/deps/zephyr/arch/arc/Kconfig"
```

## twister-out/native_sim_native/host/zephyr-course/tests/ring_buf/homework.unit.ring_buf/Kconfig/boards/Kconfig
```kconfig
# Load Zephyr board Kconfig descriptions.
osource "/home/marvin/workspace/courses/iomico_zephyr_foundation/deps/zephyr/boards/native/native_sim/Kconfig"
```

## twister-out/native_sim_native/host/zephyr-course/tests/ring_buf/homework.unit.ring_buf/Kconfig/boards/Kconfig.defconfig
```kconfig
# Load Zephyr board defconfig descriptions.
osource "/home/marvin/workspace/courses/iomico_zephyr_foundation/deps/zephyr/boards/native/native_sim/Kconfig.defconfig"
```

## twister-out/native_sim_native/host/zephyr-course/tests/ring_buf/homework.unit.ring_buf/Kconfig/boards/Kconfig.native_sim
```kconfig
# Load board Kconfig descriptions.
osource "/home/marvin/workspace/courses/iomico_zephyr_foundation/deps/zephyr/boards/native/native_sim/Kconfig.native_sim"
```
